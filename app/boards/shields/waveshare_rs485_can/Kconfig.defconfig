## app/boards/shields/waveshare_rs485_can/Kconfig.defconfig
```kconfig
# zephyr-uds-app/app/boards/shields/waveshare_rs485_can/Kconfig.defconfig

if SHIELD_WAVESHARE_RS485_CAN

config CAN
    default y

config SERIAL
    default y

config UART_INTERRUPT_DRIVEN
    default y

endif
```

## app/boards/shields/waveshare_rs485_can/Kconfig.shield
```kconfig
# zephyr-uds-app/app/boards/shields/waveshare_rs485_can/Kconfig.shield

config SHIELD_WAVESHARE_RS485_CAN
    def_bool $(shields_list_contains,waveshare_rs485_can)
```

## west.yml
```yaml
manifest:
  remotes:
    - name: zephyrproject-rtos
      url-base: https://github.com/zephyrproject-rtos

    - name: borob-engineering
      url-base: https://github.com/borob-engineering


  projects:
    - name: zephyr
      remote: zephyrproject-rtos
      revision: v4.4.0
      import: 
        name-allowlist:
          - cmsis_6
          - cmsis
          - hal_stm32
          - mcuboot

    - name: zephyr-uds
      remote: borob-engineering
      revision: main
      path: modules/lib/uds_server


  self:
    path: zephyr-uds-app
```

## zephyr/west.yml
```yaml
manifest:
  remotes:
    - name: zephyrproject-rtos
      url-base: https://github.com/zephyrproject-rtos

  projects:
    - name: zephyr
      remote: zephyrproject-rtos
      revision: v4.4.0
      import: true

    # Verknüpfung deines lokalen UDS-Modul-Ordners:
    - name: zephyr-uds-server
      path: modules/lib/uds_server
      url: file://../uds
      revision: main

  self:
    path: uds_app_project
```
